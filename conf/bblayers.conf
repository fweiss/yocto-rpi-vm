## conf/bblayers.conf
```bitbake
# POKY_BBLAYERS_CONF_VERSION is increased each time build/conf/bblayers.conf
# changes incompatibly
POKY_BBLAYERS_CONF_VERSION = "2"

BBPATH = "${TOPDIR}"
BBFILES ?= ""

BBLAYERS ?= " \
  /home/vagrant/sources/poky/meta \
  /home/vagrant/sources/poky/meta-poky \
  /home/vagrant/sources/poky/meta-yocto-bsp \
  /home/vagrant/sources/meta-openembedded/meta-oe \
  /home/vagrant/sources/meta-openembedded/meta-multimedia \
  /home/vagrant/sources/meta-openembedded/meta-networking \
  /home/vagrant/sources/meta-openembedded/meta-python \
  /home/vagrant/sources/meta-raspberrypi \
  "

# we want to ssh via usb/ethernet gadget, and sftp, and python3
IMAGE_INSTALL_append = " dropbear openssh-sftp-server usbinit python3 python3-smbus python3-pybluez \
   bluetooth pi-bluetooth bluez bluez-firmware"
  
```

## sources/meta-rover/conf/bblayers.conf.sample
```bitbake
# POKY_BBLAYERS_CONF_VERSION is increased each time build/conf/bblayers.conf
# changes incompatibly
POKY_BBLAYERS_CONF_VERSION = "2"

BBPATH = "${TOPDIR}"
BBFILES ?= ""

BBLAYERS ?= " \
  /vagrant/sources/poky/meta \
  /vagrant/sources/poky/meta-poky \
  /vagrant/sources/poky/meta-yocto-bsp \
  /vagrant/sources/meta-openembedded/meta-oe \
#  /vagrant/sources/meta-openembedded/meta-multimedia \
  /vagrant/sources/meta-openembedded/meta-networking \
  /vagrant/sources/meta-openembedded/meta-python \
  /vagrant/sources/meta-raspberrypi \
  /vagrant/sources/meta-rover \
  "

# we want to ssh via usb/ethernet gadget, and sftp, and python3
IMAGE_INSTALL_append = " dropbear openssh-sftp-server usbinit python3 python3-dbus python3-pygobject python3-pybluez \
   pi-bluetooth python3-smbus "

# python3-pygattlib
  
```
